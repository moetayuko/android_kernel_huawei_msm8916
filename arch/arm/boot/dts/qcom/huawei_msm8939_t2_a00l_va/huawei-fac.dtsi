 / {
        huawei_fac_info {
                  compatible = "huawei,hw_fac_info";
                  fac,product_name = "HUAWEI MEDIAPAD T2-A00L";
                  fac,hardware_ver = "SH0T2A01LTM"; 
                  fac,software_ver = "MSM8939_T2_A00L_VA";
                  status = "ok";
        };
};
