 / {
        huawei_fac_info {
                  compatible = "huawei,hw_fac_info";
                  fac,product_name = "Y550-L02";
                  fac,hardware_ver = "HL1Y550M";
                  fac,software_ver = "MSM8916_Y550-L02_VA";
                  status = "ok";
        };
};
