/ {
    huawei_audio_info {
        compatible = "huawei,hw_audio_info";
        product-identifier = "y550";
        builtin-master-mic-exist;
        hand_held_master_mic_strategy;
        status = "ok";
        aud_param_ver = "y550_l02_audio_A05";
        loud_speaker_master_mic_strategy;
        product-btsco-nrec-adapt;
    };
};
