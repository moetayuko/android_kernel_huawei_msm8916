 / {
        huawei_fac_info {
                  compatible = "huawei,hw_fac_info";
                  fac,product_name = "HUAWEI Y630-UL01";
                  fac,hardware_ver = "HL1ULC02UL01TM";
                  fac,software_ver = "MSM8916_Y630-UL01_VA";
                  status = "ok";
        };
};
