 / {
        huawei_fac_info {
                  compatible = "huawei,hw_fac_info";
                  fac,product_name = "HUAWEI KIW-UL00";
                  fac,hardware_ver = "HL1KIWITMAC";
                  fac,software_ver = "MSM8939_KIW_UL00_VA";
                  status = "ok";
        };
};
