 / {
        huawei_fac_info {
                  compatible = "huawei,hw_fac_info";
                  fac,product_name = "HUAWEI KIW-L21";
                  fac,hardware_ver = "HL3KIWITMAA";
                  fac,software_ver = "MSM8939_KIW_L21_VA";
                  status = "ok";
        };
};
