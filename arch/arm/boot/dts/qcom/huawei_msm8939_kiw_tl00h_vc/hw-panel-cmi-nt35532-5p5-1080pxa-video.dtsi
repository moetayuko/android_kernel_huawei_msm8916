/* Copyright (c) 2013, The Linux Foundation. All rights reserved.
 *
 * This program is free software; you can redistribute it and/or modify
 * it under the terms of the GNU General Public License version 2 and
 * only version 2 as published by the Free Software Foundation.
 *
 * This program is distributed in the hope that it will be useful,
 * but WITHOUT ANY WARRANTY; without even the implied warranty of
 * MERCHANTABILITY or FITNESS FOR A PARTICULAR PURPOSE.  See the
 * GNU General Public License for more details.
 */

/*---------------------------------------------------------------------------
 * This file is autogenerated file using gcdb parser. Please do not edit it.
 * Update input XML file to add a new entry or update variable in this file
 * VERSION = "1.0"
 *---------------------------------------------------------------------------*/
&mdss_mdp {
	dsi_cmi_nt35532_5p5_1080pxa_video: qcom,mdss_dsi_cmi_nt35532_5p5_1080pxa_video {
		qcom,mdss-dsi-panel-name = "CMI_NT35532_5P5_1080P_VIDEO";
		qcom,cont-splash-enabled;
		qcom,mdss-dsi-panel-controller = <&mdss_dsi0>;
		qcom,mdss-dsi-panel-type = "dsi_video_mode";
		qcom,mdss-dsi-panel-destination = "display_1";
		qcom,mdss-dsi-panel-clockrate = <902680000>;
		qcom,mdss-dsi-panel-framerate = <60>;
		qcom,mdss-dsi-virtual-channel-id = <0>;
		qcom,mdss-dsi-stream = <0>;
		qcom,mdss-dsi-panel-width = <1080>;
		qcom,mdss-dsi-panel-height = <1920>;
		qcom,mdss-dsi-h-front-porch = <98>;
		qcom,mdss-dsi-h-back-porch = <88>;
		qcom,mdss-dsi-h-pulse-width = <12>;
		qcom,mdss-dsi-h-sync-skew = <0>;
		qcom,mdss-dsi-v-back-porch = <8>;
		qcom,mdss-dsi-v-front-porch = <26>;
		qcom,mdss-dsi-v-pulse-width = <8>;
		qcom,mdss-dsi-h-left-border = <0>;
		qcom,mdss-dsi-h-right-border = <0>;
		qcom,mdss-dsi-v-top-border = <0>;
		qcom,mdss-dsi-v-bottom-border = <0>;
		qcom,mdss-dsi-bpp = <24>;
		qcom,mdss-dsi-underflow-color = <0x00>;
		qcom,mdss-dsi-border-color = <0>;
		qcom,mdss-dsi-color-order = "rgb_swap_rgb";
		qcom,mdss-dsi-on-command = [39 01 00 00 00 00 02 FF 01
					39 01 00 00 00 00 02 FB 01
					39 01 00 00 00 00 02 00 01
					39 01 00 00 00 00 02 01 55
					39 01 00 00 00 00 02 02 59
					39 01 00 00 00 00 02 04 0C
					39 01 00 00 00 00 02 05 3B
					39 01 00 00 00 00 02 06 6E
					39 01 00 00 00 00 02 07 C6
					39 01 00 00 00 00 02 10 03
					39 01 00 00 00 00 02 11 64
					39 01 00 00 00 00 02 12 5A
					39 01 00 00 00 00 02 16 18
					39 01 00 00 00 00 02 17 18
					39 01 00 00 00 00 02 68 13
					39 01 00 00 00 00 02 FF 04
					39 01 00 00 00 00 02 FB 01
					39 01 00 00 00 00 02 07 20
					39 01 00 00 00 00 02 08 07
					39 01 00 00 00 00 02 46 00
					39 01 00 00 00 00 02 FF 05
					39 01 00 00 00 00 02 FB 01
					39 01 00 00 00 00 02 00 40
					39 01 00 00 00 00 02 01 40
					39 01 00 00 00 00 02 02 40
					39 01 00 00 00 00 02 03 06
					39 01 00 00 00 00 02 04 40
					39 01 00 00 00 00 02 05 16
					39 01 00 00 00 00 02 06 18
					39 01 00 00 00 00 02 07 1A
					39 01 00 00 00 00 02 08 1C
					39 01 00 00 00 00 02 09 1E
					39 01 00 00 00 00 02 0A 20
					39 01 00 00 00 00 02 0B 40
					39 01 00 00 00 00 02 0C 40
					39 01 00 00 00 00 02 0D 26
					39 01 00 00 00 00 02 0E 28
					39 01 00 00 00 00 02 0F 08
					39 01 00 00 00 00 02 10 38
					39 01 00 00 00 00 02 11 38
					39 01 00 00 00 00 02 12 38
					39 01 00 00 00 00 02 13 0E
					39 01 00 00 00 00 02 14 40
					39 01 00 00 00 00 02 15 40
					39 01 00 00 00 00 02 16 40
					39 01 00 00 00 00 02 17 07
					39 01 00 00 00 00 02 18 40
					39 01 00 00 00 00 02 19 17
					39 01 00 00 00 00 02 1A 19
					39 01 00 00 00 00 02 1B 1B
					39 01 00 00 00 00 02 1C 1D
					39 01 00 00 00 00 02 1D 1F
					39 01 00 00 00 00 02 1E 21
					39 01 00 00 00 00 02 1F 40
					39 01 00 00 00 00 02 20 40
					39 01 00 00 00 00 02 21 26
					39 01 00 00 00 00 02 22 28
					39 01 00 00 00 00 02 23 09
					39 01 00 00 00 00 02 24 38
					39 01 00 00 00 00 02 25 38
					39 01 00 00 00 00 02 26 38
					39 01 00 00 00 00 02 27 0F
					39 01 00 00 00 00 02 28 40
					39 01 00 00 00 00 02 29 40
					39 01 00 00 00 00 02 2A 40
					39 01 00 00 00 00 02 2B 09
					39 01 00 00 00 00 02 2D 40
					39 01 00 00 00 00 02 2F 19
					39 01 00 00 00 00 02 30 17
					39 01 00 00 00 00 02 31 21
					39 01 00 00 00 00 02 32 1F
					39 01 00 00 00 00 02 33 1D
					39 01 00 00 00 00 02 34 1B
					39 01 00 00 00 00 02 35 40
					39 01 00 00 00 00 02 36 40
					39 01 00 00 00 00 02 37 26
					39 01 00 00 00 00 02 38 28
					39 01 00 00 00 00 02 39 07
					39 01 00 00 00 00 02 3A 38
					39 01 00 00 00 00 02 3B 38
					39 01 00 00 00 00 02 3D 38
					39 01 00 00 00 00 02 3F 0F
					39 01 00 00 00 00 02 40 40
					39 01 00 00 00 00 02 41 40
					39 01 00 00 00 00 02 42 40
					39 01 00 00 00 00 02 43 08
					39 01 00 00 00 00 02 44 40
					39 01 00 00 00 00 02 45 18
					39 01 00 00 00 00 02 46 16
					39 01 00 00 00 00 02 47 20
					39 01 00 00 00 00 02 48 1E
					39 01 00 00 00 00 02 49 1C
					39 01 00 00 00 00 02 4A 1A
					39 01 00 00 00 00 02 4B 40
					39 01 00 00 00 00 02 4C 40
					39 01 00 00 00 00 02 4D 26
					39 01 00 00 00 00 02 4E 28
					39 01 00 00 00 00 02 4F 06
					39 01 00 00 00 00 02 50 38
					39 01 00 00 00 00 02 51 38
					39 01 00 00 00 00 02 52 38
					39 01 00 00 00 00 02 53 0E
					39 01 00 00 00 00 02 54 07
					39 01 00 00 00 00 02 55 19
					39 01 00 00 00 00 02 59 24
					39 01 00 00 00 00 02 5B 4F
					39 01 00 00 00 00 02 5C 2C
					39 01 00 00 00 00 02 5D 01
					39 01 00 00 00 00 02 5E 22
					39 01 00 00 00 00 02 62 21
					39 01 00 00 00 00 02 63 69
					39 01 00 00 00 00 02 64 12
					39 01 00 00 00 00 02 66 57
					39 01 00 00 00 00 02 67 11
					39 01 00 00 00 00 02 68 2B
					39 01 00 00 00 00 02 69 12
					39 01 00 00 00 00 02 6A 05
					39 01 00 00 00 00 02 6B 29
					39 01 00 00 00 00 02 6C 08
					39 01 00 00 00 00 02 6D 18
					39 01 00 00 00 00 02 6F 3C
					39 01 00 00 00 00 02 70 03
					39 01 00 00 00 00 02 72 22
					39 01 00 00 00 00 02 73 22
					39 01 00 00 00 00 02 7D 01
					39 01 00 00 00 00 02 7E AA
					39 01 00 00 00 00 02 7F AA
					39 01 00 00 00 00 02 80 AA
					39 01 00 00 00 00 02 81 00
					39 01 00 00 00 00 02 85 3F
					39 01 00 00 00 00 02 86 3F
					39 01 00 00 00 00 02 A2 B0
					39 01 00 00 00 00 02 BD A6
					39 01 00 00 00 00 02 BE 08
					39 01 00 00 00 00 02 BF 12
					39 01 00 00 00 00 02 C8 00
					39 01 00 00 00 00 02 C9 00
					39 01 00 00 00 00 02 CA 00
					39 01 00 00 00 00 02 CB 00
					39 01 00 00 00 00 02 CC 09
					39 01 00 00 00 00 02 CE 18
					39 01 00 00 00 00 02 CF 88
					39 01 00 00 00 00 02 D0 00
					39 01 00 00 00 00 02 D1 00
					39 01 00 00 00 00 02 D2 00
					39 01 00 00 00 00 02 D3 00
					39 01 00 00 00 00 02 D4 40
					39 01 00 00 00 00 02 D6 22
					39 01 00 00 00 00 02 90 7B
					39 01 00 00 00 00 02 91 10
					39 01 00 00 00 00 02 92 10
					39 01 00 00 00 00 02 98 00
					39 01 00 00 00 00 02 99 00
					39 01 00 00 00 00 02 9F 0F
					39 01 00 00 00 00 02 FF 00
					39 01 00 00 00 00 02 FB 01
					39 01 00 00 00 00 02 BA C3
					39 01 00 00 00 00 02 D3 10
					39 01 00 00 00 00 02 D4 1a
					39 01 00 00 00 00 02 D5 14
					39 01 00 00 00 00 02 D6 14
					15 01 00 00 00 00 02 5E 28
					15 01 00 00 00 00 02 51 00
					15 01 00 00 00 00 02 53 24
					15 01 00 00 00 00 02 55 01
					05 01 00 00 78 00 02 11 00
					05 01 00 00 14 00 02 29 00];
		qcom,mdss-dsi-off-command = [39 01 00 00 00 00 02 FF 00
					39 01 00 00 00 00 02 FB 01
					05 01 00 00 14 00 02 28 00
					05 01 00 00 78 00 02 10 00];
		qcom,mdss-dsi-on-command-state = "dsi_lp_mode";
		qcom,mdss-dsi-off-command-state = "dsi_hs_mode";
		qcom,mdss-dsi-h-sync-pulse = <1>;
		qcom,mdss-dsi-traffic-mode = "burst_mode";
		qcom,mdss-dsi-lane-map = "lane_map_0123";
		qcom,mdss-dsi-bllp-eof-power-mode;
		qcom,mdss-dsi-bllp-power-mode;
		qcom,mdss-dsi-lane-0-state;
		qcom,mdss-dsi-lane-1-state;
		qcom,mdss-dsi-lane-2-state;
		qcom,mdss-dsi-lane-3-state;
		qcom,mdss-dsi-panel-timings = [ee 38 26 00 6a 6c 2c 3c 2c 03 04 00];
		qcom,mdss-dsi-t-clk-post = <0x2c>;
		qcom,mdss-dsi-t-clk-pre = <0x2c>;
		qcom,mdss-dsi-bl-min-level = <4>;
		qcom,mdss-dsi-bl-max-level = <255>;
		qcom,mdss-dsi-dma-trigger = "trigger_sw";
		qcom,mdss-dsi-mdp-trigger = "none";
		qcom,mdss-dsi-bl-pmic-control-type = "bl_ctrl_dcs";
		qcom,panel-cabc-ui-cmds = [39 01 00 00 00 00 02 FF 00
					39 01 00 00 00 00 02 FB 01
					15 01 00 00 00 00 02 55 01
					15 01 00 00 00 00 02 53 24
					];
		qcom,panel-cabc-video-cmds = [39 01 00 00 00 00 02 FF 00
					39 01 00 00 00 00 02 FB 01
					15 01 00 00 00 00 02 55 03
					15 01 00 00 00 00 02 53 2C
					];
		qcom,cabc-ui-cmds-dsi-state = "dsi_lp_mode";
		qcom,cabc-video-cmds-dsi-state = "dsi_lp_mode";
		qcom,panel-dot-inversion-mode-cmds = [39 01 00 00 00 00 02 FF 05
					39 01 00 00 00 00 02 FB 01
					39 01 00 00 00 00 02 9F 01
					39 01 00 00 00 00 02 FF 00
					39 01 00 00 00 00 02 FB 01];
		qcom,panel-column-inversion-mode-cmds = [39 01 00 00 00 00 02 FF 05
					39 01 00 00 00 00 02 FB 01
					39 01 00 00 00 00 02 9F 0F
					39 01 00 00 00 00 02 FF 00
					39 01 00 00 00 00 02 FB 01];
		qcom,dot-inversion-cmds-dsi-state = "dsi_lp_mode";
		qcom,column-inversion-cmds-dsi-state = "dsi_lp_mode";
		qcom,mdss-dsi-lp11-init;
		qcom,mdss-pan-physical-width-dimension = <68>;
		qcom,mdss-pan-physical-height-dimension = <121>;
			qcom,mdss-dsi-reset-sequence = <1 5>, <0 5>, <1 15>;

	};
};
