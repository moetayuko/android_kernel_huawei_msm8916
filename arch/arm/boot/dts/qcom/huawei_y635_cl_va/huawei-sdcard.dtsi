&soc {
        huawei,huawei-gpio-info {
                compatible = "huawei-gpio-info";
                huawei,voltage-active-low;
        };
/* remove the function of UHS as the vdd can't power cycle when SD card is pluged */

};

&sdhc_2 {
        /*add for changing the order of vdd and vddio*/
        huawei,power-off-no-card;
};
