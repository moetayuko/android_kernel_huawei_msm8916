 / {
        huawei_fac_info {
                  compatible = "huawei,hw_fac_info";
                  fac,product_name = "HUAWEI Y635-CL";
                  fac,hardware_ver = "HL1Y635CLM";
                  fac,software_ver = "MSM8916_Y635-CL_VA";
                  status = "ok";
        };
};
