 / {
        huawei_fac_info {
                  compatible = "huawei,hw_fac_info";
                  fac,product_name = "HUAWEI MEDIAPAD T2-A04l";
                  fac,hardware_ver = "SH0T2A04LM";
                  fac,software_ver = "MSM8939_T2_A04L_VA";
                  status = "ok";
        };
};
