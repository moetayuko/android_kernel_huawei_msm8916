 / {
        huawei_fac_info {
                  compatible = "huawei,hw_fac_info";
                  fac,product_name = "G621-TL00";
                  fac,hardware_ver = "HL1G621M0";
                  fac,software_ver = "MSM8916_G621-TL_VB";
                  status = "ok";
        };
};
