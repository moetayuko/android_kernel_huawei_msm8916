 / {
        huawei_fac_info {
                  compatible = "huawei,hw_fac_info";
                  fac,product_name = "HUAWEI MEDIAPAD T2-A01L";
                  fac,hardware_ver = "SH0T2A01LM";
                  fac,software_ver = "MSM8939_T2_A01L_VA";
                  status = "ok";
        };
};
