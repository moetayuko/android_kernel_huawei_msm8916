 / {
        huawei_fac_info {
                  compatible = "huawei,hw_fac_info";
                  fac,product_name = "HUAWEI KIW-CL00";
                  fac,hardware_ver = "HL1KIWITMAB";
                  fac,software_ver = "MSM8939_KIW_CL00_VA";
                  status = "ok";
        };
};
