/ {
        huawei_wifi_info {
                  compatible = "huawei,hw_wifi_info";
                  status = "ok";
                  wifi,chiptype = "WIFI_QUALCOMM_WCN3660B";
                  wifi,pubfile_id = "t18_823l_va";
                  wifi,fw_ver = "1.4.1.2";
        };
};
