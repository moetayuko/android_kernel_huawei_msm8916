/* Copyright (c) 2014, The Linux Foundation. All rights reserved.
 *
 * This program is free software; you can redistribute it and/or modify
 * it under the terms of the GNU General Public License version 2 and
 * only version 2 as published by the Free Software Foundation.
 *
 * This program is distributed in the hope that it will be useful,
 * but WITHOUT ANY WARRANTY; without even the implied warranty of
 * MERCHANTABILITY or FITNESS FOR A PARTICULAR PURPOSE.  See the
 * GNU General Public License for more details.
 */
/dts-v1/;
#include "msm8939.dtsi"
#include "msm8939-qrd-skuk.dtsi"
#include "huawei_msm8939_g760s_cl_va/huawei.dtsi"
/ {
	model = "Qualcomm MSM 8939 HUAWEI G760S-CL";
	compatible = "qcom,msm8939-qrd", "qcom,msm8939", "qcom,qrd";
	qcom,board-id = <8008 0> , <8008 4>;
	huawei,modem_id = <0xFFBC0080 0x0>;
};
