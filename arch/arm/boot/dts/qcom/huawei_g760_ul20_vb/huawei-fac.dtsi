 / {
        huawei_fac_info {
                  compatible = "huawei,hw_fac_info";
                  fac,product_name = "HUAWEI G7-UL20";
                  fac,hardware_ver = "HL1G760SM";
                  fac,software_ver = "MSM8916_G760-UL20_VB";
                  status = "ok";
        };
};
