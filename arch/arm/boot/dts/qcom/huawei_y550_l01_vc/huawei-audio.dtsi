/ {
    huawei_audio_info {
        compatible = "huawei,hw_audio_info";
        product-identifier = "y550_l01_vc";
        builtin-master-mic-exist;
        builtin-2nd-mic-exist;
        hand_held_dual_mic_strategy;
        status = "ok";
        aud_param_ver = "y550_l01_audio_B15";
        loud_speaker_second_mic_strategy;
        product-btsco-nrec-adapt;
    };
};
