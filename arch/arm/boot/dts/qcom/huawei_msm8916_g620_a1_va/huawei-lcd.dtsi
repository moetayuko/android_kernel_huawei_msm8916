/*---------------------------------------------------------------------------
 * This file is autogenerated file using huawei LCD parser. Please do not edit it.
 * Update input XML file to add a new entry or update variable in this file
 * Parser location: device/qcom/common/display/tools/huawei_lcd_panel 
 *---------------------------------------------------------------------------*/


#include "hw-panel-cmi-otm1284a-5-720p-video.dtsi"
#include "hw-panel-tianma-otm1283a-5-720p-video.dtsi"
