 / {
        huawei_fac_info {
                  compatible = "huawei,hw_fac_info";
                  fac,product_name = "HUAWEI KIW-L22";
                  fac,hardware_ver = "HL3KIWITMAC";
                  fac,software_ver = "MSM8939_KIW_L22_VA";
                  status = "ok";
        };
};
