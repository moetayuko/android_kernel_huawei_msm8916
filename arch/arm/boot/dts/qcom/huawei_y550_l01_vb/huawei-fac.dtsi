 / {
        huawei_fac_info {
                  compatible = "huawei,hw_fac_info";
                  fac,product_name = "Y550-L01";
                  fac,hardware_ver = "HL3Y550M";
                  fac,software_ver = "MSM8916_Y550-L01_VB";
                  status = "ok";
        };
};
