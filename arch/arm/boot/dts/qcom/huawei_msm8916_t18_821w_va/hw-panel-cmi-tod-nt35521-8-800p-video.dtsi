/* Copyright (c) 2013, The Linux Foundation. All rights reserved.
 *
 * This program is free software; you can redistribute it and/or modify
 * it under the terms of the GNU General Public License version 2 and
 * only version 2 as published by the Free Software Foundation.
 *
 * This program is distributed in the hope that it will be useful,
 * but WITHOUT ANY WARRANTY; without even the implied warranty of
 * MERCHANTABILITY or FITNESS FOR A PARTICULAR PURPOSE.  See the
 * GNU General Public License for more details.
 */

/*---------------------------------------------------------------------------
 * This file is autogenerated file using gcdb parser. Please do not edit it.
 * Update input XML file to add a new entry or update variable in this file
 * VERSION = "1.0"
 *---------------------------------------------------------------------------*/
&mdss_mdp {
	dsi_cmi_tod_nt35521_8_800p_video: qcom,mdss_dsi_cmi_tod_nt35521_8_800p_video {
		qcom,mdss-dsi-panel-name = "CMI_TOD_NT35521_8_800P_VIDEO";
		qcom,cont-splash-enabled;
		qcom,mdss-dsi-panel-controller = <&mdss_dsi0>;
		qcom,mdss-dsi-panel-type = "dsi_video_mode";
		qcom,mdss-dsi-panel-destination = "display_1";
		qcom,mdss-dsi-panel-clockrate = <487000000>;
		qcom,mdss-dsi-panel-framerate = <60>;
		qcom,mdss-dsi-virtual-channel-id = <0>;
		qcom,mdss-dsi-stream = <0>;
		qcom,mdss-dsi-panel-width = <800>;
		qcom,mdss-dsi-panel-height = <1280>;
		qcom,mdss-dsi-h-front-porch = <108>;
		qcom,mdss-dsi-h-back-porch = <108>;
		qcom,mdss-dsi-h-pulse-width = <12>;
		qcom,mdss-dsi-h-sync-skew = <0>;
		qcom,mdss-dsi-v-back-porch = <16>;
		qcom,mdss-dsi-v-front-porch = <16>;
		qcom,mdss-dsi-v-pulse-width = <4>;
		qcom,mdss-dsi-h-left-border = <0>;
		qcom,mdss-dsi-h-right-border = <0>;
		qcom,mdss-dsi-v-top-border = <0>;
		qcom,mdss-dsi-v-bottom-border = <0>;
		qcom,mdss-dsi-bpp = <24>;
		qcom,mdss-dsi-underflow-color = <0xff>;
		qcom,mdss-dsi-border-color = <0>;
		qcom,mdss-dsi-color-order = "rgb_swap_rgb";
		qcom,mdss-dsi-on-command = [29 01 00 00 00 00 05 FF AA 55 A5 80
		          29 01 00 00 00 00 03 6F 11 00            
		      	  29 01 00 00 00 00 03 F7 20 00             
			  15 01 00 00 00 00 02 F4 03            
		      	  15 01 00 00 00 00 02 6F 06         
		      	  15 01 00 00 00 00 02 F7 A0         
		      	  15 01 00 00 00 00 02 6F 19         
		      	  15 01 00 00 00 00 02 F7 12              
		      	  29 01 00 00 00 00 06 F0 55 AA 52 08 00   
		      	  15 01 00 00 00 00 02 C8 80           
		      	  29 01 00 00 00 00 03 B1 60 01            
		      	  15 01 00 00 00 00 02 B6 08           
		      	  15 01 00 00 00 00 02 6F 02           
		      	  15 01 00 00 00 00 02 B8 08           
		      	  29 01 00 00 00 00 03 BB 74 44             
		      	  29 01 00 00 00 00 03 BC 00 00             
		      	  29 01 00 00 00 00 06 BD 02 B0 0C 0A 00   
		      	  29 01 00 00 00 00 06 F0 55 AA 52 08 01   
			  29 01 00 00 00 00 03 B9 34 34
			  29 01 00 00 00 00 03 BA 14 14
		      	  29 01 00 00 00 00 03 B0 05 05            
		      	  29 01 00 00 00 00 03 B1 05 05            
		      	  29 01 00 00 00 00 03 BC 90 01            
		      	  29 01 00 00 00 00 03 BD 90 01            
		      	  15 01 00 00 00 00 02 CA 00          
		      	  15 01 00 00 00 00 02 C0 04          		      
		      	  29 01 00 00 00 00 03 B3 37 37            
		      	  29 01 00 00 00 00 03 B4 19 19            
		      	  29 01 00 00 00 00 03 B9 45 45            
		      	  29 01 00 00 00 00 03 BA 25 25            
		      	  29 01 00 00 00 00 06 F0 55 AA 52 08 02   
		      	  15 01 00 00 00 00 02 EE 03    
			  29 01 00 00 00 00 05 EF 09 06 15 18 
		      	  29 01 00 00 00 00 07 B0 00 01 00 22 00 45
		      	  15 01 00 00 00 00 02 6F 06   
		      	  29 01 00 00 00 00 07 B0 00 5D 00 6F 00 A0
		      	  15 01 00 00 00 00 02 6F 0C 
		      	  29 01 00 00 00 00 05 B0 00 C5 01 02   
		      	  29 01 00 00 00 00 07 B1 01 2F 01 78 01 B0
		      	  15 01 00 00 00 00 02 6F 06   
		      	  29 01 00 00 00 00 07 B1 02 09 02 50 02 53
		      	  15 01 00 00 00 00 02 6F 0C 
		      	  29 01 00 00 00 00 05 B1 02 96 02 DF   
		      	  29 01 00 00 00 00 07 B2 03 0D 03 4B 03 75
		      	  15 01 00 00 00 00 02 6F 06  
		      	  29 01 00 00 00 00 07 B2 03 98 03 B0 03 CC
		      	  15 01 00 00 00 00 02 6F 0C   
		      	  29 01 00 00 00 00 05 B2 03 DC 03 F1    
		      	  29 01 00 00 00 00 05 B3 03 FA 03 FF    
		      	  29 01 00 00 00 00 07 B4 00 A7 00 B0 00 C2
		      	  15 01 00 00 00 00 02 6F 06 
		      	  29 01 00 00 00 00 07 B4 00 D4 00 E0 00 FE
		      	  15 01 00 00 00 00 02 6F 0C  
		      	  29 01 00 00 00 00 05 B4 01 16 01 3F   
		      	  29 01 00 00 00 00 07 B5 01 63 01 9D 01 CE
		      	  15 01 00 00 00 00 02 6F 06 
		      	  29 01 00 00 00 00 07 B5 02 1D 02 60 02 63
		      	  15 01 00 00 00 00 02 6F 0C  
		      	  29 01 00 00 00 00 05 B5 02 A2 02 E9  
		      	  29 01 00 00 00 00 07 B6 03 18 03 56 03 80
		      	  15 01 00 00 00 00 02 6F 06 
		      	  29 01 00 00 00 00 07 B6 03 A2 03 B7 03 D2
		      	  15 01 00 00 00 00 02 6F 0C 
		      	  29 01 00 00 00 00 05 B6 03 E1 03 F1    
		      	  29 01 00 00 00 00 05 B7 03 FE 03 FF     
		      	  29 01 00 00 00 00 07 B8 00 59 00 62 00 76
		      	  15 01 00 00 00 00 02 6F 06   
		      	  29 01 00 00 00 00 07 B8 00 8D 00 9D 00 C1
		      	  15 01 00 00 00 00 02 6F 0C 
		      	  29 01 00 00 00 00 05 B8 00 E1 01 16  
		      	  29 01 00 00 00 00 07 B9 01 3E 01 82 01 B8
		      	  15 01 00 00 00 00 02 6F 06
		      	  29 01 00 00 00 00 07 B9 02 0E 02 55 02 58
		      	  15 01 00 00 00 00 02 6F 0C    
		      	  29 01 00 00 00 00 05 B9 02 9A 02 E3     
		      	  29 01 00 00 00 00 07 BA 03 12 03 53 03 81
		      	  15 01 00 00 00 00 02 6F 06
		      	  29 01 00 00 00 00 07 BA 03 A8 03 BE 03 D5
		      	  15 01 00 00 00 00 02 6F 0C   
		      	  29 01 00 00 00 00 05 BA 03 DF 03 EE       
		      	  29 01 00 00 00 00 05 BB 03 FC 03 FF      
		      	  29 01 00 00 00 00 06 F0 55 AA 52 08 06
		      	  29 01 00 00 00 00 03 B0 00 10             
		      	  29 01 00 00 00 00 03 B1 12 14             
		      	  29 01 00 00 00 00 03 B2 16 18             
		      	  29 01 00 00 00 00 03 B3 1A 29             
		      	  29 01 00 00 00 00 03 B4 2A 08             
		      	  29 01 00 00 00 00 03 B5 31 31             
		      	  29 01 00 00 00 00 03 B6 31 31             
		      	  29 01 00 00 00 00 03 B7 31 31             
		      	  29 01 00 00 00 00 03 B8 31 0A             
		      	  29 01 00 00 00 00 03 B9 31 31             
		      	  29 01 00 00 00 00 03 BA 31 31             
		      	  29 01 00 00 00 00 03 BB 0B 31             
		      	  29 01 00 00 00 00 03 BC 31 31             
		      	  29 01 00 00 00 00 03 BD 31 31             
		      	  29 01 00 00 00 00 03 BE 31 31             
		      	  29 01 00 00 00 00 03 BF 09 2A             
		      	  29 01 00 00 00 00 03 C0 29 1B             
		      	  29 01 00 00 00 00 03 C1 19 17             
		      	  29 01 00 00 00 00 03 C2 15 13             
		      	  29 01 00 00 00 00 03 C3 11 01             
		      	  29 01 00 00 00 00 03 E5 31 31             
		      	  29 01 00 00 00 00 03 C4 09 1B             
		      	  29 01 00 00 00 00 03 C5 19 17             
		      	  29 01 00 00 00 00 03 C6 15 13             
		      	  29 01 00 00 00 00 03 C7 11 29             
		      	  29 01 00 00 00 00 03 C8 2A 01             
		      	  29 01 00 00 00 00 03 C9 31 31             
		      	  29 01 00 00 00 00 03 CA 31 31             
		      	  29 01 00 00 00 00 03 CB 31 31             
		      	  29 01 00 00 00 00 03 CC 31 0B             
		      	  29 01 00 00 00 00 03 CD 31 31             
		      	  29 01 00 00 00 00 03 CE 31 31             
		      	  29 01 00 00 00 00 03 CF 0A 31             
		      	  29 01 00 00 00 00 03 D0 31 31             
		      	  29 01 00 00 00 00 03 D1 31 31             
		      	  29 01 00 00 00 00 03 D2 31 31             
		      	  29 01 00 00 00 00 03 D3 00 2A             
		      	  29 01 00 00 00 00 03 D4 29 10             
		      	  29 01 00 00 00 00 03 D5 12 14             
		      	  29 01 00 00 00 00 03 D6 16 18             
		      	  29 01 00 00 00 00 03 D7 1A 08             
		      	  29 01 00 00 00 00 03 E6 31 31             
		      	  29 01 00 00 00 00 06 D8 00 00 00 54 00   
		      	  29 01 00 00 00 00 06 D9 00 15 00 00 00   
		      	  15 01 00 00 00 00 02 E7 00               
		      	  29 01 00 00 00 00 06 F0 55 AA 52 08 03   
		      	  29 01 00 00 00 00 03 B0 20 00            
		      	  29 01 00 00 00 00 03 B1 20 00           
		      	  29 01 00 00 00 00 06 B2 05 00 00 00 00   
		      	  29 01 00 00 00 00 06 B6 05 00 00 00 00   
		      	  29 01 00 00 00 00 06 B7 05 00 00 00 00   
		      	  29 01 00 00 00 00 06 BA 57 00 00 00 00   
		      	  29 01 00 00 00 00 06 BB 57 00 00 00 00   
		      	  29 01 00 00 00 00 05 C0 00 00 00 00     
		      	  29 01 00 00 00 00 05 C1 00 00 00 00     
		      	  15 01 00 00 00 00 02 C4 60            
		      	  15 01 00 00 00 00 02 C5 40             
		      	  29 01 00 00 00 00 06 F0 55 AA 52 08 05   
		      	  29 01 00 00 00 00 06 BD 03 01 03 03 03   
		      	  29 01 00 00 00 00 03 B0 17 06           
		      	  29 01 00 00 00 00 03 B1 17 06           
		      	  29 01 00 00 00 00 03 B2 17 06           
		      	  29 01 00 00 00 00 03 B3 17 06           
		      	  29 01 00 00 00 00 03 B4 17 06           
		      	  29 01 00 00 00 00 03 B5 17 06           
		      	  15 01 00 00 00 00 02 B8 00            
		      	  15 01 00 00 00 00 02 B9 00            
		      	  15 01 00 00 00 00 02 BA 00            
		      	  15 01 00 00 00 00 02 BB 02            
		      	  15 01 00 00 00 00 02 BC 00            
		      	  15 01 00 00 00 00 02 C0 07            
		      	  15 01 00 00 00 00 02 C4 80            
		      	  15 01 00 00 00 00 02 C5 A4            
		      	  29 01 00 00 00 00 03 C8 05 30             
		      	  29 01 00 00 00 00 03 C9 01 31             
		      	  29 01 00 00 00 00 04 CC 00 00 3C          
		      	  29 01 00 00 00 00 04 CD 00 00 3C          
		      	  29 01 00 00 00 00 06 D1 00 04 FD 07 10   
		      	  29 01 00 00 00 00 06 D2 00 05 02 07 10   
		      	  15 01 00 00 00 00 02 E5 06             
		      	  15 01 00 00 00 00 02 E6 06             
		      	  15 01 00 00 00 00 02 E7 06             
		      	  15 01 00 00 00 00 02 E8 06             
		      	  15 01 00 00 00 00 02 E9 06             
		      	  15 01 00 00 00 00 02 EA 06             
		      	  15 01 00 00 00 00 02 ED 30             
		      	  15 01 00 00 00 00 02 6F 11             
		      	  15 01 00 00 00 00 02 F3 01             
		      	  15 01 00 00 00 00 02 53 2C            
		      	  15 01 00 00 00 00 02 55 01       
	            15 01 00 00 00 00 02 51 00     
	            29 01 00 00 00 00 06 F0 55 AA 52 08 00                        
	            29 01 00 00 00 00 0D CC 00 00 00 00 00 00 00 00 00 00 00 00 
	            29 01 00 00 00 00 0D D7 00 00 00 00 00 22 24 26 28 26 22 00		
	            29 01 00 00 00 00 0E D8 00 00 00 00 00 00 00 00 00 00 00 00 00	            	                      
	            15 01 00 00 00 00 02 55 81      
	            05 01 00 00 00 00 02 35 00                              
	            05 01 00 00 00 00 02 11 00                                                                                                     			                                                       
			        05 01 00 00 00 00 02 29 00];
		qcom,mdss-dsi-off-command = [05 01 00 00 32 00 02 28 00
					    05 01 00 00 78 00 02 10 00];
		qcom,mdss-dsi-on-command-state = "dsi_lp_mode";
		qcom,mdss-dsi-off-command-state = "dsi_hs_mode";
		qcom,mdss-dsi-h-sync-pulse = <1>;
		qcom,mdss-dsi-traffic-mode = "burst_mode";
		qcom,mdss-dsi-lane-map = "lane_map_0123";
		qcom,mdss-dsi-bllp-eof-power-mode;
		qcom,mdss-dsi-bllp-power-mode;
		qcom,mdss-dsi-lane-0-state;
		qcom,mdss-dsi-lane-1-state;
		qcom,mdss-dsi-lane-2-state;
		qcom,mdss-dsi-lane-3-state;
		qcom,mdss-dsi-panel-timings = [8B 1E 14 00 44 48 18 22 19 03 04 00];
		qcom,mdss-dsi-t-clk-post = <0x04>;
		qcom,mdss-dsi-t-clk-pre = <0x1C>;
		qcom,mdss-dsi-bl-min-level = <6>;
		qcom,mdss-dsi-bl-max-level = <255>;
		qcom,mdss-dsi-dma-trigger = "trigger_sw";
		qcom,mdss-dsi-mdp-trigger = "none";
		qcom,mdss-dsi-bl-pmic-control-type = "bl_ctrl_dcs";
		qcom,panel-cabc-ui-cmds = [15 01 00 00 00 00 02 55 81
					15 01 00 00 00 00 02 53 2C];
		qcom,panel-cabc-video-cmds = [15 01 00 00 00 00 02 55 83
					15 01 00 00 00 00 02 53 2C];
		qcom,cabc-ui-cmds-dsi-state = "dsi_hs_mode";
		qcom,cabc-video-cmds-dsi-state = "dsi_hs_mode";
		qcom,mdss-dsi-lp11-init;
		huawei,delaytime-before-bl = <80>;
			qcom,mdss-dsi-reset-sequence = <1 1>, <0 20>, <1 120>;

	};
};
