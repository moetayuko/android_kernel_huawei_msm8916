/* Copyright (c) 2013, The Linux Foundation. All rights reserved.
 *
 * This program is free software; you can redistribute it and/or modify
 * it under the terms of the GNU General Public License version 2 and
 * only version 2 as published by the Free Software Foundation.
 *
 * This program is distributed in the hope that it will be useful,
 * but WITHOUT ANY WARRANTY; without even the implied warranty of
 * MERCHANTABILITY or FITNESS FOR A PARTICULAR PURPOSE.  See the
 * GNU General Public License for more details.
 */

/*---------------------------------------------------------------------------
 * This file is autogenerated file using gcdb parser. Please do not edit it.
 * Update input XML file to add a new entry or update variable in this file
 * VERSION = "1.0"
 *---------------------------------------------------------------------------*/
&mdss_mdp {
	dsi_boe_bp080wx1_8_800p_video: qcom,mdss_dsi_boe_bp080wx1_8_800p_video {
		qcom,mdss-dsi-panel-name = "BOE_BP080WX_8_800P_VIDEO";
		qcom,cont-splash-enabled;
		qcom,mdss-dsi-panel-controller = <&mdss_dsi0>;
		qcom,mdss-dsi-panel-type = "dsi_video_mode";
		qcom,mdss-dsi-panel-destination = "display_1";
		qcom,mdss-dsi-panel-framerate = <60>;
		qcom,mdss-dsi-virtual-channel-id = <0>;
		qcom,mdss-dsi-stream = <0>;
		qcom,mdss-dsi-panel-width = <800>;
		qcom,mdss-dsi-panel-height = <1280>;
		qcom,mdss-dsi-h-front-porch = <128>;
		qcom,mdss-dsi-h-back-porch = <128>;
		qcom,mdss-dsi-h-pulse-width = <4>;
		qcom,mdss-dsi-h-sync-skew = <0>;
		qcom,mdss-dsi-v-back-porch = <4>;
		qcom,mdss-dsi-v-front-porch = <8>;
		qcom,mdss-dsi-v-pulse-width = <4>;
		qcom,mdss-dsi-h-left-border = <0>;
		qcom,mdss-dsi-h-right-border = <0>;
		qcom,mdss-dsi-v-top-border = <0>;
		qcom,mdss-dsi-v-bottom-border = <0>;
		qcom,mdss-dsi-bpp = <24>;
		qcom,mdss-dsi-underflow-color = <0xff>;
		qcom,mdss-dsi-border-color = <0>;
		qcom,mdss-dsi-color-order = "rgb_swap_rgb";
		qcom,mdss-dsi-on-command = [29 01 00 00 00 00 03 F0 5A 5A 
              29 01 00 00 00 00 03 F1 5A 5A 
              29 01 00 00 00 00 03 FC A5 A5 
              29 01 00 00 00 00 03 D0 00 10 
              15 01 00 00 00 00 02 B1 10
              29 01 00 00 00 00 05 B2 14 22 2F 04 
              29 01 00 00 00 00 06 F2 02 08 04 90 10 
              15 01 00 00 00 00 02 B0 03
              29 01 00 00 00 00 03 FD 23 09 
              29 01 00 00 00 00 0B F3 01 D7 E2 62 F4 F7 77 3C 26 00
              29 01 00 00 00 00 2E F4 00 02 03 26 03 02 09 00 07 16 16 03 00 08 08 03 0E 0F 12 1C 1D 1E 0C 09 01 04 02 61 74 75 72 83 80 80 B0 00 01 01 28 04 03 28 01 D1 32 
              15 01 00 00 00 00 02 B0 01                 
              29 01 00 00 00 00 1A F5 2F 2F 5F AB 98 52 0F 33 43 04 59 54 52 05 40 60 4E 60 40 27 26 52 25 6D 18
              29 01 00 00 00 00 09 EE 25 00 25 00 25 00 25 00
              29 01 00 00 00 00 09 EF 34 12 98 BA 20 00 24 80
              29 01 00 00 00 00 21 F7 0E 0E 0A 0A 0F 0F 0B 0B 05 07 01 01 01 01 01 01 0C 0C 08 08 0D 0D 09 09 04 06 01 01 01 01 01 01 
              29 01 00 00 00 00 04 BC 01 4E 0A                   
              29 01 00 00 00 00 06 E1 03 10 1C A0 10
              29 01 00 00 00 00 07 F6 60 21 A6 00 00 00
              29 01 00 00 00 00 07 FE 00 0D 03 21 00 48 
              15 01 00 00 00 00 02 B0 22                    
              29 01 00 00 00 00 12 FA 02 34 0A 15 0E 13 19 17 16 1B 1B 18 19 15 11 16 1F 
              15 01 00 00 00 00 02 B0 22                  
              29 01 00 00 00 00 12 FB 00 34 08 13 0C 11 17 15 14 19 1D 18 19 15 11 16 1F 
              15 01 00 00 00 00 02 B0 11                   
              29 01 00 00 00 00 12 FA 02 34 0E 16 0E 14 18 17 16 19 1A 19 18 15 12 18 21 
              15 01 00 00 00 00 02 B0 11                 
              29 01 00 00 00 00 12 FB 00 34 0C 14 0C 12 16 13 14 1B 1B 17 17 14 12 19 22 
              29 01 00 00 00 00 12 FA 02 34 12 1F 14 18 1D 1B 19 1D 1D 19 19 16 14 22 30 
              29 01 00 00 00 00 12 FB 00 34 12 1D 12 16 1B 19 17 1B 1B 18 18 14 14 23 31 
              29 01 00 00 00 00 04 C3 92 00 28 
              05 01 00 00 00 00 02 35 00
              15 01 00 00 00 00 02 53 2C
              15 01 00 00 00 00 02 55 01	
              15 01 00 00 00 00 02 51 00
              05 01 00 00 00 00 02 11 00
              05 01 00 00 00 00 02 29 00];
		qcom,mdss-dsi-off-command = [05 01 00 00 14 00 02 28 00
					     05 01 00 00 78 00 02 10 00];
		qcom,mdss-dsi-on-command-state = "dsi_lp_mode";
		qcom,mdss-dsi-off-command-state = "dsi_hs_mode";
		qcom,mdss-dsi-h-sync-pulse = <1>;
		qcom,mdss-dsi-traffic-mode = "burst_mode";
		qcom,mdss-dsi-lane-map = "lane_map_0123";
		qcom,mdss-dsi-bllp-eof-power-mode;
		qcom,mdss-dsi-bllp-power-mode;
		qcom,mdss-dsi-lane-0-state;
		qcom,mdss-dsi-lane-1-state;
		qcom,mdss-dsi-lane-2-state;
		qcom,mdss-dsi-lane-3-state;
		qcom,mdss-dsi-panel-timings = [8A 1F 14 00 45 4A 19 23 23 03 04 00];
		qcom,mdss-dsi-t-clk-post = <0x04>;
		qcom,mdss-dsi-t-clk-pre = <0x1d>;
		qcom,mdss-dsi-bl-min-level = <1>;
		qcom,mdss-dsi-bl-max-level = <255>;
		qcom,mdss-dsi-dma-trigger = "trigger_sw";
		qcom,mdss-dsi-mdp-trigger = "none";
		qcom,mdss-dsi-bl-pmic-control-type = "bl_ctrl_dcs";
		qcom,panel-inverse-off-cmds = [05 01 00 00 14 00 02 28 00];
		qcom,panel-inverse-on-cmds = [05 01 00 00 14 00 02 29 00];
		qcom,inverse-on-cmds-dsi-state = "dsi_hs_mode";
		qcom,inverse-off-cmds-dsi-state = "dsi_hs_mode";
		qcom,panel-cabc-ui-cmds = [29 01 00 00 00 00 06 F0 55 AA 52 08 00
29 01 00 00 00 00 0B E3 F3 F3 EC EC EC E7 E7 E7 DF DF
15 01 00 00 00 00 02 53 2C];
		qcom,panel-cabc-video-cmds = [29 01 00 00 00 00 06 F0 55 AA 52 08 00
29 01 00 00 00 00 0B E3 F0 D2 C3 B4 A5 96 87 87 87 81
15 01 00 00 00 00 02 53 2C];
		qcom,cabc-ui-cmds-dsi-state = "dsi_hs_mode";
		qcom,cabc-video-cmds-dsi-state = "dsi_hs_mode";
		qcom,mdss-dsi-lp11-init;
		qcom,mdss-dsi-mipi-rst-delay = <80>;
			qcom,mdss-dsi-reset-sequence = <1 1>, <0 20>, <1 120>;

	};
};
