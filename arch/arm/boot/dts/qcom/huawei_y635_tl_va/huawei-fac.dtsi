 / {
        huawei_fac_info {
                  compatible = "huawei,hw_fac_info";
                  fac,product_name = "HUAWEI Y635-TL";
                  fac,hardware_ver = "HL1Y635TLTM";
                  fac,software_ver = "MSM8916_Y635-TL_VA";
                  status = "ok";
        };
};
