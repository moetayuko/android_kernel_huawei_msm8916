&tlmm_pinmux {
	usb-id-pin {
		qcom,pins = <&gp 117>;
		qcom,num-grp-pins = <1>;
		qcom,pin-func = <0>;
		label = "usb-id-pin";
		usbid_default: default {
			drive-strength = <8>;
			bias-pull-up;
		};
	};
};
&usb_otg {
	qcom,hsusb-otg-mode = <3>;
	qcom,usbid-gpio = <&msm_gpio 117 0>; 
	pinctrl-names = "default"; 
	pinctrl-0 = <&usbid_default>;
	vbus_otg-supply = <&max77819_otg_supply>;
};
