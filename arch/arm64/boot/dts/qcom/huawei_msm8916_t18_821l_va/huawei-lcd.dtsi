/*---------------------------------------------------------------------------
 * This file is autogenerated file using huawei LCD parser. Please do not edit it.
 * Update input XML file to add a new entry or update variable in this file
 * Parser location: device/qcom/common/display/tools/huawei_lcd_panel 
 *---------------------------------------------------------------------------*/


#include "hw-panel-boe_bp080wx1-8-800p-video.dtsi"
#include "hw-panel-boe_new_bp080wx1-8-800p-video.dtsi"
#include "hw-panel-cmi-nt35521-8-800p-video.dtsi"
#include "hw-panel-cmi-tod-nt35521-8-800p-video.dtsi"
