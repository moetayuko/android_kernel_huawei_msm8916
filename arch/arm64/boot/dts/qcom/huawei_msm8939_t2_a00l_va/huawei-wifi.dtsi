 / {
        huawei_wifi_info {
                  compatible = "huawei,hw_wifi_info";
                  status = "ok";
                  wifi,chiptype = "2.6";
                  wifi,pubfile_id = "t2_a00l_va";
                  wifi,fw_ver = "QCOM_WCN3680B";
                  wifi,softap_feature = "wps";
        };
};
