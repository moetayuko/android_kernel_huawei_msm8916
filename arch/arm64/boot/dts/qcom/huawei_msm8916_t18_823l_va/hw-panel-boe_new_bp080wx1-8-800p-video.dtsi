/* Copyright (c) 2013, The Linux Foundation. All rights reserved.
 *
 * This program is free software; you can redistribute it and/or modify
 * it under the terms of the GNU General Public License version 2 and
 * only version 2 as published by the Free Software Foundation.
 *
 * This program is distributed in the hope that it will be useful,
 * but WITHOUT ANY WARRANTY; without even the implied warranty of
 * MERCHANTABILITY or FITNESS FOR A PARTICULAR PURPOSE.  See the
 * GNU General Public License for more details.
 */

/*---------------------------------------------------------------------------
 * This file is autogenerated file using gcdb parser. Please do not edit it.
 * Update input XML file to add a new entry or update variable in this file
 * VERSION = "1.0"
 *---------------------------------------------------------------------------*/
&mdss_mdp {
	dsi_boe_new_bp080wx1_8_800p_video: qcom,mdss_dsi_boe_new_bp080wx1_8_800p_video {
		qcom,mdss-dsi-panel-name = "BOE_NEW_BP080WX_8_800P_VIDEO";
		qcom,cont-splash-enabled;
		qcom,mdss-dsi-panel-controller = <&mdss_dsi0>;
		qcom,mdss-dsi-panel-type = "dsi_video_mode";
		qcom,mdss-dsi-panel-destination = "display_1";
		qcom,mdss-dsi-panel-clockrate = <477000000>;
		qcom,mdss-dsi-panel-framerate = <60>;
		qcom,mdss-dsi-virtual-channel-id = <0>;
		qcom,mdss-dsi-stream = <0>;
		qcom,mdss-dsi-panel-width = <800>;
		qcom,mdss-dsi-panel-height = <1280>;
		qcom,mdss-dsi-h-front-porch = <108>;
		qcom,mdss-dsi-h-back-porch = <108>;
		qcom,mdss-dsi-h-pulse-width = <4>;
		qcom,mdss-dsi-h-sync-skew = <0>;
		qcom,mdss-dsi-v-back-porch = <8>;
		qcom,mdss-dsi-v-front-porch = <8>;
		qcom,mdss-dsi-v-pulse-width = <4>;
		qcom,mdss-dsi-h-left-border = <0>;
		qcom,mdss-dsi-h-right-border = <0>;
		qcom,mdss-dsi-v-top-border = <0>;
		qcom,mdss-dsi-v-bottom-border = <0>;
		qcom,mdss-dsi-bpp = <24>;
		qcom,mdss-dsi-underflow-color = <0xff>;
		qcom,mdss-dsi-border-color = <0>;
		qcom,mdss-dsi-color-order = "rgb_swap_rgb";
		qcom,mdss-dsi-on-command = [29 01 00 00 00 00 06 F0 55 AA 52 08 00
		29 01 00 00 00 00 03 B1 EE 01
		29 01 00 00 00 00 05 B8 02 06 21 00
		29 01 00 00 00 00 03 BA 22 26
		29 01 00 00 00 00 05 E6 FF FF FB DA
		29 01 00 00 00 00 07 CC 11 11 11 00 00 00
		29 01 00 00 00 00 0D CE 10 10 10 10 10 10 10 10 10 10 10 10
		29 01 00 00 00 00 0D D7 09 09 09 00 01 00 00 00 01 00 00 00
		29 01 00 00 00 00 0D D8 00 00 00 09 09 09 00 00 00 00 09 09
		29 01 00 00 00 00 06 F0 55 AA 52 08 01
		15 01 00 00 00 00 02 B2 01     
		15 01 00 00 00 00 02 CA 00     
		15 01 00 00 00 00 02 CE 34     
		29 01 00 00 00 00 03 BC 68 01
		29 01 00 00 00 00 03 BD 68 01
		29 01 00 00 00 00 06 F0 55 AA 52 08 03
		29 01 00 00 00 00 05 B0 00 23 00 00
		29 01 00 00 00 00 08 B2 01 00 06 04 00 D8 42
		29 01 00 00 00 00 08 B3 01 00 05 04 00 D8 42
		29 01 00 00 00 00 08 BA 85 03 00 04 01 D8 42
		29 01 00 00 00 00 08 BB 85 03 00 03 01 D8 42
		29 01 00 00 00 00 06 F0 55 AA 52 08 02
		15 01 00 00 00 00 02 B0 40          
		29 01 00 00 00 00 11 D1 00 00 00 12 00 3C 00 55 00 78 00 9D 00 BE 00 F0
		29 01 00 00 00 00 11 D2 01 18 01 59 01 8E 01 DD 02 1F 02 21 02 5D 02 9E
		29 01 00 00 00 00 11 D3 02 C6 03 00 03 26 03 59 03 7A 03 A2 03 BB 03 D8
		29 01 00 00 00 00 05 D4 03 F6 03 FF                 
		29 01 00 00 00 00 06 F0 55 AA 52 08 06           
		15 01 00 00 00 00 02 B3 03                                   
		29 01 00 00 00 00 06 B1 19 18 18 02 3A           
		29 01 00 00 00 00 03 B2 3A 3A                             
		29 01 00 00 00 00 06 B6 13 12 12 00 3A           
		29 01 00 00 00 00 05 FF AA 55 A5 80                 
		15 01 00 00 00 00 02 6F 09                                   
		15 01 00 00 00 00 02 F7 82                                   
		15 01 00 00 00 00 02 6F 0B                                   
		15 01 00 00 00 00 02 F7 E0                                   
		15 01 00 00 00 00 02 55 81                                   
		15 01 00 00 00 00 02 53 2C                                   
		15 01 00 00 00 00 02 51 00                                   
		05 01 00 00 00 00 02 11 00                                   
		05 01 00 00 00 00 02 29 00];
		qcom,mdss-dsi-off-command = [05 01 00 00 10 00 02 28 00
		05 01 00 00 05 00 02 10 00];
		qcom,mdss-dsi-on-command-state = "dsi_lp_mode";
		qcom,mdss-dsi-off-command-state = "dsi_hs_mode";
		qcom,mdss-dsi-h-sync-pulse = <1>;
		qcom,mdss-dsi-traffic-mode = "burst_mode";
		qcom,mdss-dsi-lane-map = "lane_map_0123";
		qcom,mdss-dsi-bllp-eof-power-mode;
		qcom,mdss-dsi-bllp-power-mode;
		qcom,mdss-dsi-lane-0-state;
		qcom,mdss-dsi-lane-1-state;
		qcom,mdss-dsi-lane-2-state;
		qcom,mdss-dsi-lane-3-state;
		qcom,mdss-dsi-panel-timings = [86 1E 14 00 42 46 18 20 16 03 04 00];
		qcom,mdss-dsi-t-clk-post = <0x04>;
		qcom,mdss-dsi-t-clk-pre = <0x1B>;
		qcom,mdss-dsi-bl-min-level = <6>;
		qcom,mdss-dsi-bl-max-level = <255>;
		qcom,mdss-dsi-dma-trigger = "trigger_sw";
		qcom,mdss-dsi-mdp-trigger = "none";
		qcom,mdss-dsi-bl-pmic-control-type = "bl_ctrl_dcs";
		qcom,panel-inverse-off-cmds = [05 01 00 00 00 00 02 20 00];
		qcom,panel-inverse-on-cmds = [05 01 00 00 00 00 02 21 00];
		qcom,inverse-on-cmds-dsi-state = "dsi_lp_mode";
		qcom,inverse-off-cmds-dsi-state = "dsi_lp_mode";
		qcom,panel-cabc-ui-cmds = [15 01 00 00 00 00 02 55 81
15 01 00 00 00 00 02 53 2C];
		qcom,panel-cabc-video-cmds = [15 01 00 00 00 00 02 55 83
15 01 00 00 00 00 02 53 2C];
		qcom,cabc-ui-cmds-dsi-state = "dsi_hs_mode";
		qcom,cabc-video-cmds-dsi-state = "dsi_hs_mode";
		qcom,mdss-dsi-lp11-init;
		qcom,mdss-dsi-mipi-rst-delay = <80>;
			qcom,mdss-dsi-reset-sequence = <1 1>, <0 20>, <1 120>;

	};
};
