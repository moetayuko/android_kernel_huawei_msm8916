## drivers/devdetect/Kconfig
```kconfig
#
# Near Field Communication (NFC) devices
#

config HUAWEI_HW_DEV_DCT
	depends on HUAWEI_KERNEL
	default n
	bool "HUAWEI DEVICE DETECT"
	help
		Say yes if you want i2c device detect driver.
		This is for i2c connected version. If unsure, say N here.

config HUAWEI_HW_SIM_DETECT
	depends on HUAWEI_KERNEL
	default n
	bool "HUAWEI SIM DEVICE DETECT"
	help
		Say yes if you want sim device detect driver.
		This is for sim plugin version. If unsure, say N here.
```

## drivers/platform/huawei/Kconfig
```kconfig
# Huawei configuration options

config MACH_HUAWEI
	bool "Huawei device"
	depends on ARCH_MSM
	help
	  Support for Huawei products

config MACH_HUAWEI_MSM8916
	bool "HUAWEI MSM8916"
	depends on ARCH_MSM8916
	select MACH_HUAWEI
	help
	  Support for MSM8916 Huawei variants
```
